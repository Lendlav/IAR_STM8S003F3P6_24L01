#include "main.h"
#include "SSD1306.h"

//----------------------------------------------------------------------------------
#define FONT_BASE_ADDRESS       0x4000  //адрес размещения шрифтов

#define BUFF_SIZE       512

#define column_start  0
#define column_end    127
#define page_start    0
#define page_end      3

//----------------------------------------------------------------------------------
u8  lcd_buff[BUFF_SIZE];
u16 lcd_buff_idx=0;
u8  x_cur=0, y_cur=0;

const u8 comm[]={ 
   0xAE,             //Display Off
   0xD5,0x80,
   
   0xA8,0x1F,        //Set Multiplex Ratio     1F - 128x32, 3F - 128x64
            
   0xD3,0x00,        //Set Display Offset
   0x40,
   
   0x8D,0x14,        // Charge Pump set:   0x10 = VCC Supplied Externally  
                     // 0x14 = VCC Generated by Internal
   
   //[1:0] = 00b, Horizontal Addressing Mode
   //[1:0] = 01b, Vertical Addressing Mode
   //[1:0] = 10b, Page Addressing Mode (RESET)
   //[1:0] = 11b, Invalid
   0x20,0x01,        //Set Memory Addressing Mode 
   
   0xA0,             //Set Segment Re-map  A0/A1
   0xC0,             //Vertical flip    C0/C8
   
   0xDA,0x02,        //Set COM Pins Hardware Configuration  0x10 - 128x64, 0x02 - 128x32
   
   0x81,0x00,        //Set Contrast Control 
   
   0xD9,0xF1,        //Set Pre-Charge Period:  0x22 = VCC Supplied Externally  \
                     //0xF1 = VCC Generated by Internal             
      
   0xDB,0x40,        //Set VCOMH Deselect Level
      
   0xA4,             //Set Entire Display On/Off
   0xA6,             //Set NORMAL/INVERT Display   A6/A7
   
   0xAF,             //Display On
   
   0xFF
};
//----------------------------------------------------------------------------------
void LCD_Mode(u8 mode)
{
  LCD_command(0x20);
  LCD_command(mode);
}
//----------------------------------------------------------------------------------
void LCD_Flip(u8 flip)
{
  if(flip)
  {
    LCD_command(0xA0);
    LCD_command(0xC0);
  }
  else
  {
    LCD_command(0xA1);
    LCD_command(0xC8);
  }
}
//----------------------------------------------------------------------------------
void LCD_Init(void)
{
  u8 ix = 0;
  while(comm[ix]!=0xFF)
  {
     LCD_command(comm[ix]);
     ix++;
  }
}
//----------------------------------------------------------------------------------
void LCD_Contrast(u8 contrast)
{
   LCD_command(0x81);
   LCD_command(contrast);
}
//----------------------------------------------------------------------------------
void LCD_On(void)
{
   LCD_command(0xAF);
}
//----------------------------------------------------------------------------------
void LCD_Off(void)
{
   LCD_command(0xAE);
}
//----------------------------------------------------------------------------------
void LCD_Clear(void)
{
   u16 ix;
   for(ix=0;ix<BUFF_SIZE;ix++)
   {
      lcd_buff[ix]=0x00;
   }
   x_cur=0;
   y_cur=0;
}
//----------------------------------------------------------------------------------

void LCD_Update(void)
{
   u16 ix = 0;

   LCD_command(0x21);             // SSD1306_COLUMNADDR
   LCD_command(column_start);     // column start
   LCD_command(column_end);       // column end
   LCD_command(0x22);             // SSD1306_PAGEADDR
   LCD_command(page_start);       // page start
   LCD_command(page_end);         // page end (4 pages for 32 rows OLED)
   
   disableInterrupts();
   
   I2C->CR2 |= I2C_CR2_START;   ///I2C_GenerateSTART(ENABLE);
   while (!I2C_CheckEvent(I2C_EVENT_MASTER_MODE_SELECT));
   I2C_Send7bitAddress(SLAVE_ADDRESS, I2C_DIRECTION_TX);
   while (!I2C_CheckEvent(I2C_EVENT_MASTER_TRANSMITTER_MODE_SELECTED));
   I2C->DR = DATA_MODE;         //I2C_SendData(DATA_MODE);
   while (!I2C_CheckEvent(I2C_EVENT_MASTER_BYTE_TRANSMITTING));  
   
   for(ix=0;ix<BUFF_SIZE;ix++)
   {
     I2C->DR = lcd_buff[ix];    //I2C_SendData(lcd_buff[ix]);
     while (!I2C_CheckEvent(I2C_EVENT_MASTER_BYTE_TRANSMITTING));
   } 
   I2C->CR2 |= I2C_CR2_STOP;    //I2C_GenerateSTOP(ENABLE);
   
   enableInterrupts();
}
//----------------------------------------------------------------------------------
void LCD_Chr(u8 ch, u8 invers)
{
   u8 i;   
   lcd_buff_idx=y_cur*128+x_cur*6;    
   if ((ch>=0x20)&&(ch<=0x7F)) ch-=32;
   else if (ch>=0xC0) ch-=96;
   else ch = 95;   
   for (i=0;i<5;i++)
   {
     if(invers)
      lcd_buff[lcd_buff_idx++] = ~(font[ch][i]);
     else
       lcd_buff[lcd_buff_idx++] = font[ch][i];
   }
   if(invers)                           //depict space between symbols
     lcd_buff[lcd_buff_idx++] = 0xFF; 
   else
     lcd_buff[lcd_buff_idx++] = 0x00; 
    
   x_cur++;
   if (x_cur>20)
   {
      x_cur=0;
      y_cur++;
      if (y_cur>3)
      {
         y_cur=0;
      }
   }
}
//----------------------------------------------------------------------------------
void LCD_2xChr(u8 ch)
{
   u8	i, c;
   u8	b1, b2;  
   u16	tmpIdx;
   
   lcd_buff_idx = (y_cur*128 + x_cur*6)+1;
   tmpIdx       = lcd_buff_idx - 128;
   if ((ch>=0x20)&&(ch<=0x7F)) ch-=32;
   else if (ch>=0xC0) ch-= 96;
   else               ch = 95;
   
   for ( i = 0; i < 5; i++ ){
      c = font[ch][i];//<<1;
      b1=(c&0x01)*3;
      b1|=(c&0x02)*6;
      b1|=(c&0x04)*12;
      b1|=(c&0x08)*24;
      
      c>>=4;
      b2=(c&0x01)*3;
      b2|=(c&0x02)*6;
      b2|=(c&0x04)*12;
      b2|=(c&0x08)*24;
      
      lcd_buff[tmpIdx++]=b1;
      lcd_buff[tmpIdx++]=b1;
      lcd_buff[tmpIdx+126]=b2;
      lcd_buff[tmpIdx+127]=b2;
   }
   lcd_buff_idx=(lcd_buff_idx+11)%BUFF_SIZE;
   lcd_buff[lcd_buff_idx]=0x00;    
   if(lcd_buff_idx==(BUFF_SIZE-1)) lcd_buff_idx=1;
   else lcd_buff_idx++;
   x_cur=x_cur+2;
   if (x_cur>19){
      x_cur=0;
      y_cur=y_cur+2;
      if (y_cur>3){
         y_cur=0;
      }
   }
}
//----------------------------------------------------------------------------------
void LCD_FStr(const u8 *dataPtr,u8 x,u8 y, u8 invers)
{
   LCD_GotoXY(x,y);
   while(*dataPtr!=0)
   {
      LCD_Chr(*dataPtr, invers);
      dataPtr++;
   }
}
//----------------------------------------------------------------------------------
void LCD_2xFStr(const u8 *dataPtr,u8 x,u8 y)
{
   LCD_GotoXY(x,y);
   while(*dataPtr!=0)
   {
      LCD_2xChr(*dataPtr);
      dataPtr++;
   }
}
//----------------------------------------------------------------------------------
void LCD_GotoXY(u8 x,u8 y)
{
    if((x<21)&&(y<4))
    {
      x_cur=x;
      y_cur=y;
    }
}
//------------------------------------------------------------------------------  
void LCD_Picture(const u8 *Picture)
{
//  LCD_Clear();
//  for (lcd_buff_idx=0;lcd_buff_idx<BUFF_SIZE;lcd_buff_idx++)
//  {
//    lcd_buff[lcd_buff_idx] = Picture[lcd_buff_idx];
//  } 
//  LCD_Update();
}
//------------------------------------------------------------------------------ 
void LCD_Batt(int val)
{ 
  if(val<0)val = 0;
  u8 bat_arr[] = 
  { 
    0x3C, 0x3C, 0xFF, 0x81, 0x81, 0x81, 
    0x81, 0x81, 0x81, 0x81, 0x81, 0x81, 
    0x81, 0x81, 0x81, 0x81, 0x81, 0x81, 
    0x81, 0xFF 
  };
  
  u8 cnt_val = 17;
  while(val>0)
  {      
    bat_arr[cnt_val--]= 0xBD; 
    val -=15;
  }
  lcd_buff_idx=483;
  for(u8 i=0;i<20;i++)
  {
    lcd_buff[lcd_buff_idx++]=bat_arr[i];
  }
}
//----------------------------------------------------------------------------------

void  LCD_command(u8 cmd)
{
start: 
  u8 count_wdt =0;
  I2C->CR2 |= I2C_CR2_START; 
  while (!I2C_CheckEvent(I2C_EVENT_MASTER_MODE_SELECT))
  {
    if(count_wdt++>10)goto start;
  }
  I2C_Send7bitAddress(SLAVE_ADDRESS, I2C_DIRECTION_TX);
  
  count_wdt = 0;
  while (!I2C_CheckEvent(I2C_EVENT_MASTER_TRANSMITTER_MODE_SELECTED))
  {
    if(count_wdt++>10)goto start;
  }
  // bit Co = 0, D/C# = 0
  I2C->DR = COMMAND_MODE;      
  while (!I2C_CheckEvent(I2C_EVENT_MASTER_BYTE_TRANSMITTING));   
  I2C->DR = cmd;              
  while (!I2C_CheckEvent(I2C_EVENT_MASTER_BYTE_TRANSMITTING));
  I2C->CR2 |= I2C_CR2_STOP;  
}
////----------------------------------------------------------------------------------
/*
 * Таблица для отображения символов (ASCII[0x20-0x7F] + CP1251[0xC0-0xFF] = всего 160 символов)
 */
const  u8 font [][5] @ (FONT_BASE_ADDRESS+0x0020) =    //  - начальный адрес для размещения шрифтов
{
   { 0x00, 0x00, 0x00, 0x00, 0x00 },   //   0x20  32
   { 0x00, 0x00, 0x5F, 0x00, 0x00 },   // ! 0x21  33
   { 0x00, 0x07, 0x00, 0x07, 0x00 },   // " 0x22  34
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   { 0x1C, 0x3E, 0x7C, 0x3E, 0x1C },   // 0x7F сердечко

//   { 0x7C, 0x12, 0x11, 0x12, 0x7C },   // А 0xC0 192
//   { 0x7F, 0x49, 0x49, 0x49, 0x31 },   // Б 0xC1 193
//   { 0x7F, 0x49, 0x49, 0x49, 0x36 },   // В 0xC2 194
//   { 0x7F, 0x01, 0x01, 0x01, 0x01 },   // Г 0xC3 195
//   { 0x60, 0x3F, 0x21, 0x3F, 0x60 },   // Д 0xC4 196
//   { 0x7F, 0x49, 0x49, 0x49, 0x41 },   // Е 0xC5 197
//   { 0x77, 0x08, 0x7F, 0x08, 0x77 },   // Ж 0xC6 198
//   { 0x22, 0x41, 0x49, 0x49, 0x36 },   // З 0xC7 199
//   { 0x7F, 0x10, 0x08, 0x04, 0x7F },   // И 0xC8 200
//   { 0x7E, 0x10, 0x09, 0x04, 0x7E },   // Й 0xC9 201
//   { 0x7F, 0x08, 0x14, 0x22, 0x41 },   // К 0xCA 202
//   { 0x40, 0x3E, 0x01, 0x01, 0x7F },   // Л 0xCB 203
//   { 0x7F, 0x02, 0x0C, 0x02, 0x7F },   // М 0xCC 204
//   { 0x7F, 0x08, 0x08, 0x08, 0x7F },   // Н 0xCD 205
//   { 0x3E, 0x41, 0x41, 0x41, 0x3E },   // О 0xCE 206
//   { 0x7F, 0x01, 0x01, 0x01, 0x7F },   // П 0xCF 207
//   { 0x7F, 0x09, 0x09, 0x09, 0x06 },   // Р 0xD0 208
//   { 0x3E, 0x41, 0x41, 0x41, 0x22 },   // С 0xD1 209
//   { 0x01, 0x01, 0x7F, 0x01, 0x01 },   // Т 0xD2 210
//   { 0x07, 0x48, 0x48, 0x48, 0x3F },   // У 0xD3 211
//   { 0x0E, 0x11, 0x7F, 0x11, 0x0E },   // Ф 0xD4 212
//   { 0x63, 0x14, 0x08, 0x14, 0x63 },   // Х 0xD5 213
//   { 0x3F, 0x20, 0x20, 0x3F, 0x60 },   // Ц 0xD6 214
//   { 0x07, 0x08, 0x08, 0x08, 0x7F },   // Ч 0xD7 215
//   { 0x7F, 0x40, 0x7E, 0x40, 0x7F },   // Ш 0xD8 216
//   { 0x3F, 0x20, 0x3F, 0x20, 0x7F },   // Щ 0xD9 217
//   { 0x01, 0x7F, 0x48, 0x48, 0x30 },   // Ъ 0xDA 218
//   { 0x7F, 0x48, 0x30, 0x00, 0x7F },   // Ы 0xDB 219
//   { 0x00, 0x7F, 0x48, 0x48, 0x30 },   // Ь 0xDC 220
//   { 0x22, 0x41, 0x49, 0x49, 0x3E },   // Э 0xDD 221
//   { 0x7F, 0x08, 0x3E, 0x41, 0x3E },   // Ю 0xDE 222
//   { 0x46, 0x29, 0x19, 0x09, 0x7F },   // Я 0xDF 223
//   { 0x20, 0x54, 0x54, 0x54, 0x78 },   // а 0xE0 224
//   { 0x3C, 0x4A, 0x4A, 0x4A, 0x31 },   // б 0xE1 225
//   { 0x7C, 0x54, 0x54, 0x28, 0x00 },   // в 0xE2 226
//   { 0x7C, 0x04, 0x04, 0x0C, 0x00 },   // г 0xE3 227
//   { 0x60, 0x3C, 0x24, 0x3C, 0x60 },   // д 0xE4 228
//   { 0x38, 0x54, 0x54, 0x54, 0x18 },   // е 0xE5 229
//   { 0x6C, 0x10, 0x7C, 0x10, 0x6C },   // ж 0xE6 230
//   { 0x00, 0x44, 0x54, 0x54, 0x28 },   // з 0xE7 231
//   { 0x7C, 0x20, 0x10, 0x08, 0x7C },   // и 0xE8 232
//   { 0x7C, 0x21, 0x12, 0x09, 0x7C },   // й 0xE9 233
//   { 0x7C, 0x10, 0x28, 0x44, 0x00 },   // к 0xEA 234
//   { 0x40, 0x38, 0x04, 0x04, 0x7C },   // л 0xEB 235
//   { 0x7C, 0x08, 0x10, 0x08, 0x7C },   // м 0xEC 236
//   { 0x7C, 0x10, 0x10, 0x10, 0x7C },   // н 0xED 237
//   { 0x38, 0x44, 0x44, 0x44, 0x38 },   // о 0xEE 238
//   { 0x7C, 0x04, 0x04, 0x04, 0x7C },   // п 0xEF 239
//   { 0x7C, 0x14, 0x14, 0x14, 0x08 },   // р 0xF0 240
//   { 0x38, 0x44, 0x44, 0x44, 0x00 },   // с 0xF1 241
//   { 0x04, 0x04, 0x7C, 0x04, 0x04 },   // т 0xF2 242
//   { 0x0C, 0x50, 0x50, 0x50, 0x3C },   // у 0xF3 243
//   { 0x08, 0x14, 0x7C, 0x14, 0x08 },   // ф 0xF4 244
//   { 0x44, 0x28, 0x10, 0x28, 0x44 },   // х 0xF5 245
//   { 0x3C, 0x20, 0x20, 0x3C, 0x60 },   // ц 0xF6 246
//   { 0x0C, 0x10, 0x10, 0x10, 0x7C },   // ч 0xF7 247
//   { 0x7C, 0x40, 0x7C, 0x40, 0x7C },   // ш 0xF8 248
//   { 0x3C, 0x20, 0x3C, 0x20, 0x7C },   // щ 0xF9 249
//   { 0x04, 0x7C, 0x50, 0x50, 0x20 },   // ъ 0xFA 250
//   { 0x7C, 0x50, 0x20, 0x00, 0x7C },   // ы 0xFB 251
//   { 0x00, 0x7C, 0x50, 0x50, 0x20 },   // ь 0xFC 252
//   { 0x28, 0x44, 0x54, 0x54, 0x38 },   // э 0xFD 253
//   { 0x7C, 0x10, 0x38, 0x44, 0x38 },   // ю 0xFE 254
//   { 0x48, 0x54, 0x34, 0x14, 0x7C }    // я 0xFF 255
};

